# file: 14-exemplo-matriz-rgb.ioc
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Dma.Request0=TIM3_CH4
Dma.TIM3_CH4.0.Direction=DMA_MEMORY_TO_PERIPH
Dma.TIM3_CH4.0.EventEnable=DISABLE
Dma.TIM3_CH4.0.Instance=DMA1_Channel3
Dma.TIM3_CH4.0.MemDataAlignment=DMA_MDATAALIGN_HALFWORD
Dma.TIM3_CH4.0.MemInc=DMA_MINC_ENABLE
Dma.TIM3_CH4.0.Mode=DMA_NORMAL
Dma.TIM3_CH4.0.PeriphDataAlignment=DMA_PDATAALIGN_HALFWORD
Dma.TIM3_CH4.0.PeriphInc=DMA_PINC_DISABLE
Dma.TIM3_CH4.0.Polarity=HAL_DMAMUX_REQ_GEN_RISING
Dma.TIM3_CH4.0.Priority=DMA_PRIORITY_LOW
Dma.TIM3_CH4.0.RequestNumber=1
Dma.TIM3_CH4.0.SignalID=NONE
Dma.TIM3_CH4.0.SyncEnable=DISABLE
Dma.TIM3_CH4.0.SyncPolarity=HAL_DMAMUX_SYNC_NO_EVENT
Dma.TIM3_CH4.0.SyncRequestNumber=1
Dma.TIM3_CH4.0.SyncSignalID=NONE
Mcu.Family=STM32C0
Mcu.Name=STM32C011F(4-6)Px
Mcu.Package=TSSOP20
NVIC.DMA1_Channel2_3_IRQn=true\:0\:0\:false\:false\:true\:false\:true\:true
PA13.Mode=Serial_Wire
PA13.Signal=DEBUG_SWDIO
PA14-BOOT0.Mode=Serial_Wire
PA14-BOOT0.Signal=DEBUG_SWCLK
PB7.Signal=S_TIM3_CH4
ProjectManager.HeapSize=0x200
ProjectManager.StackSize=0x400
ProjectManager.TargetToolchain=STM32CubeIDE
RCC.ADCFreq_Value=48000000
RCC.AHBFreq_Value=48000000
RCC.CortexFreq_Value=48000000
RCC.EXTERNAL_CLOCK_VALUE=12288000
RCC.HCLKFreq_Value=48000000
RCC.HSE_VALUE=8000000
RCC.HSISYSCLKDivider=RCC_HSI_DIV1
RCC.HSI_VALUE=48000000
RCC.LSE_VALUE=32768
RCC.SYSCLKFreq_VALUE=48000000
SH.S_TIM3_CH4.0=TIM3_CH4,PWM Generation4 CH4
TIM3.AutoReloadPreload=TIM_AUTORELOAD_PRELOAD_DISABLE
TIM3.Channel-PWM\ Generation4\ CH4=TIM_CHANNEL_4
TIM3.Period=(60 - 1)
VP_TIM3_VS_ClockSourceINT.Mode=Internal
board=custom

// file: Core/Src/main.c
/* USER CODE BEGIN Header */
/**
  ******************************************************************************
  * @file           : main.c
  * @brief          : Main program body
  ******************************************************************************
  * @attention
  *
  * Copyright (c) 2023 STMicroelectronics.
  * All rights reserved.
  *
  * This software is licensed under terms that can be found in the LICENSE file
  * in the root directory of this software component.
  * If no LICENSE file comes with this software, it is provided AS-IS.
  *
  ******************************************************************************
  */
/* USER CODE END Header */
#include "main.h"
#include "dma.h"
#include "tim.h"
#include "gpio.h"

/* USER CODE BEGIN Includes */

#include "isr.h"
#include "led_matrix.h"
#include "rgb.h"
#include "ws2812.h"

/* USER CODE END Includes */

void SystemClock_Config(void);

int main(void)
{

  /* MCU Configuration--------------------------------------------------------*/

  /* Reset of all peripherals, Initializes the Flash interface and the Systick. */
  HAL_Init();

  /* Configure the system clock */
  SystemClock_Config();

  /* Initialize all configured peripherals */
  MX_GPIO_Init();
  MX_DMA_Init();
  MX_TIM3_Init();
  /* USER CODE BEGIN 2 */

	LED_init();

	LED_write_matrix();

	RGB_R = 0x10;
	RGB_G = 0;
	RGB_B = 0x10;

	RGB_state = red;

  /* USER CODE END 2 */

  /* Infinite loop */
  /* USER CODE BEGIN WHILE */
  while (1)
  {

	  // shift LED Matrix
	  for (LED_id = 1; LED_id < LED_MATRIX_NUM_LEDS; LED_id++)
	  {
		  LED_matrix_data[LED_MATRIX_NUM_LEDS - LED_id][0] = LED_matrix_data[LED_MATRIX_NUM_LEDS - LED_id - 1][0];
		  LED_matrix_data[LED_MATRIX_NUM_LEDS - LED_id][1] = LED_matrix_data[LED_MATRIX_NUM_LEDS - LED_id - 1][1];
		  LED_matrix_data[LED_MATRIX_NUM_LEDS - LED_id][2] = LED_matrix_data[LED_MATRIX_NUM_LEDS - LED_id - 1][2];
	  }
	  // new color (sweep)
	  RGB_sweep();

	  // Add new color to 1st LED
	  LED_set_color(0, RGB_R, RGB_G, RGB_B);

	  LED_write_matrix();

	  // Delay
	  HAL_Delay(50);

	  // Repeat

    /* USER CODE END WHILE */

  }
}

void SystemClock_Config(void)
{
  RCC_OscInitTypeDef RCC_OscInitStruct = {0};
  RCC_ClkInitTypeDef RCC_ClkInitStruct = {0};

  /** Initializes the RCC Oscillators according to the specified parameters
  * in the RCC_OscInitTypeDef structure.
  */
  RCC_OscInitStruct.OscillatorType = RCC_OSCILLATORTYPE_HSI;
  RCC_OscInitStruct.HSIState = RCC_HSI_ON;
  RCC_OscInitStruct.HSIDiv = RCC_HSI_DIV1;
  RCC_OscInitStruct.HSICalibrationValue = RCC_HSICALIBRATION_DEFAULT;
  if (HAL_RCC_OscConfig(&RCC_OscInitStruct) != HAL_OK)
  {
    Error_Handler();
  }

  /** Initializes the CPU, AHB and APB buses clocks
  */
  RCC_ClkInitStruct.ClockType = RCC_CLOCKTYPE_HCLK|RCC_CLOCKTYPE_SYSCLK
                              |RCC_CLOCKTYPE_PCLK1;
  RCC_ClkInitStruct.SYSCLKSource = RCC_SYSCLKSOURCE_HSI;
  RCC_ClkInitStruct.SYSCLKDivider = RCC_SYSCLK_DIV1;
  RCC_ClkInitStruct.AHBCLKDivider = RCC_HCLK_DIV1;
  RCC_ClkInitStruct.APB1CLKDivider = RCC_APB1_DIV1;

  if (HAL_RCC_ClockConfig(&RCC_ClkInitStruct, FLASH_LATENCY_1) != HAL_OK)
  {
    Error_Handler();
  }
}

void Error_Handler(void)
{
  __disable_irq();
  while (1)
  {
  }
}
